## boards/shields/swoop/Kconfig.shield
```kconfig
# Copyright (c) 2021 The ZMK Contributors
# SPDX-License-Identifier: MIT

config SHIELD_SWOOP_LEFT
	def_bool $(shields_list_contains,swoop_left)

config SHIELD_SWOOP_RIGHT
	def_bool $(shields_list_contains,swoop_right)
```

## config/Kconfig.defconfig
```kconfig
# Copyright (c) 2021 The ZMK Contributors
# SPDX-License-Identifier: MIT

if SHIELD_SWOOP_LEFT

config ZMK_KEYBOARD_NAME
	default "Swoop"

config ZMK_SPLIT_BLE_ROLE_CENTRAL
	default y
	
endif

if SHIELD_SWOOP_LEFT || SHIELD_SWOOP_RIGHT

config ZMK_SPLIT
	default y

endif
```
